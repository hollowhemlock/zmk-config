#define CONFIG_WIRELESS
#define L_ZMK_BASE(name, LT, RT, LM, RM, LB, RB, LH, RH)                   \
    ZMK_LAYER(                                                                 \
        name,                                                                  \
                 LT RT                                                         \
                 LM RM                                                         \
                 LB RB                                                         \
                 LH RH                                                         \
    )

#include "zmk-helpers/key-labels/34.h"
#include "base.keymap"
